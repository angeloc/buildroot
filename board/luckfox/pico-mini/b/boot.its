## package/qt6/python-pyside6/Config.in
```kconfig
config BR2_PACKAGE_PYTHON_PYSIDE6
	bool "python-pyside6"
	depends on BR2_PACKAGE_PYTHON3
	depends on BR2_PACKAGE_QT6
	depends on BR2_PACKAGE_QT6_GL_SUPPORTS # QtGui OpenGL classes
	depends on BR2_PACKAGE_LLVM_ARCH_SUPPORTS # python-shiboken6
	select BR2_PACKAGE_PYTHON_SHIBOKEN6
	select BR2_PACKAGE_QT6BASE_GUI
	select BR2_PACKAGE_QT6BASE_OPENGL
	select BR2_PACKAGE_QT6BASE_WIDGETS
	select BR2_PACKAGE_OPENSSL if BR2_PACKAGE_QT6BASE_NETWORK # QtNetwork SSL classes
	help
	  Qt for Python, the official Python bindings of Qt6.

	  The bindings are built for the Qt6 modules enabled in the
	  configuration.

	  Select a Qt platform plugin with
	  BR2_PACKAGE_QT6BASE_DEFAULT_QPA at build time, or with the
	  QT_QPA_PLATFORM environment variable at run time.

	  The pyside6-uic and pyside6-rcc tools are not provided: use
	  "$(HOST_DIR)/libexec/uic -g python" and
	  "$(HOST_DIR)/libexec/rcc -g python" instead to convert .ui
	  and .qrc files to Python code.

	  https://doc.qt.io/qtforpython-6/

comment "python-pyside6 needs an OpenGL-capable backend"
	depends on BR2_PACKAGE_PYTHON3
	depends on BR2_PACKAGE_QT6
	depends on BR2_PACKAGE_LLVM_ARCH_SUPPORTS
	depends on !BR2_PACKAGE_QT6_GL_SUPPORTS
```

## package/qt6/python-shiboken6/Config.in
```kconfig
config BR2_PACKAGE_PYTHON_SHIBOKEN6
	bool "python-shiboken6"
	depends on BR2_PACKAGE_PYTHON3
	depends on BR2_PACKAGE_QT6
	depends on BR2_PACKAGE_LLVM_ARCH_SUPPORTS # host-clang
	select BR2_PACKAGE_PYTHON3_ZLIB # embedded signature support
	help
	  Shiboken is the Python binding generator used by PySide6.
	  This package provides the Shiboken6 Python module and
	  library needed at runtime by the generated bindings.

	  https://doc.qt.io/qtforpython-6/shiboken6/index.html
```

## package/qt6cinex/Config.in
```kconfig
config BR2_PACKAGE_QT6CINEX
	bool "qt6cinex"
	depends on BR2_PACKAGE_QT6
	depends on BR2_PACKAGE_QT6_GL_SUPPORTS
	select BR2_PACKAGE_QT6BASE_GUI
	select BR2_PACKAGE_QT6BASE_OPENGL
	select BR2_PACKAGE_QT6DECLARATIVE
	select BR2_PACKAGE_QT6DECLARATIVE_QUICK
	select BR2_PACKAGE_QT6SHADERTOOLS
	help
	  Qt6 port of the Qt5 Cinematic Experience demo, showing some
	  graphical features of Qt Quick: shader effects, particles
	  and animations.

	  https://github.com/alpqr/qt5-cinematic-experience

comment "qt6cinex needs an OpenGL-capable backend"
	depends on BR2_PACKAGE_QT6
	depends on !BR2_PACKAGE_QT6_GL_SUPPORTS
```

## package/qwt/Config.in
```kconfig
config BR2_PACKAGE_QWT
	bool "qwt"
	depends on BR2_PACKAGE_QT6
	select BR2_PACKAGE_QT6BASE_GUI
	select BR2_PACKAGE_QT6BASE_WIDGETS
	select BR2_PACKAGE_QT6BASE_PRINTSUPPORT
	select BR2_PACKAGE_QT6BASE_CONCURRENT
	help
	  Qwt is a graphics extension to the Qt GUI application
	  framework. It provides a 2D plotting widget and more.

	  http://qwt.sourceforge.net/

if BR2_PACKAGE_QWT

config BR2_PACKAGE_QWT_SVG
	bool "SVG support"
	select BR2_PACKAGE_QT6SVG

config BR2_PACKAGE_QWT_MATHML
	bool "MathML support"

config BR2_PACKAGE_QWT_OPENGL
	bool "OpenGL support"
	depends on BR2_PACKAGE_QT6_GL_SUPPORTS
	select BR2_PACKAGE_QT6BASE_OPENGL

endif
```

## package/rkdeveloptool/Config.in.host
```kconfig
config BR2_PACKAGE_HOST_RKDEVELOPTOOL
	bool "host rkdeveloptool"
	depends on BR2_HOST_GCC_AT_LEAST_4_9 # host-libusb
	help
	  Tool to communicate with Rockchip SoCs in USB download
	  (maskrom/loader) mode: it packs and downloads the USB
	  loader, and reads, writes and erases the storage.

	  https://github.com/rockchip-linux/rkdeveloptool

comment "host rkdeveloptool needs a toolchain w/ host gcc >= 4.9"
	depends on !BR2_HOST_GCC_AT_LEAST_4_9
```

## package/rockchip-rkbin/Config.in
```kconfig
config BR2_PACKAGE_ROCKCHIP_RKBIN
	bool "rockchip-rkbin"
	depends on BR2_arm || BR2_aarch64
	help
	  This package provides Rockchip SoC binary blobs for U-Boot.

if BR2_PACKAGE_ROCKCHIP_RKBIN

config BR2_PACKAGE_ROCKCHIP_RKBIN_TPL_FILENAME
	string "Rockchip rkbin tpl file path"
	help
	  Path to the tpl file inside the rkbin repository. The
	  specified file will be copied and used by U-Boot as tpl.

config BR2_PACKAGE_ROCKCHIP_RKBIN_BL31_FILENAME
	string "Rockchip rkbin bl31 file path"
	help
	  Path to the bl31 file inside the rkbin repository. The
	  specified file will be copied and used by U-Boot as bl31.

config BR2_PACKAGE_ROCKCHIP_RKBIN_TEE_FILENAME
	string "Rockchip rkbin tee file path"
	help
	  Path to the TEE file inside the rkbin repository. The
	  specified file will be copied and used by U-Boot as TEE.

config BR2_PACKAGE_ROCKCHIP_RKBIN_USB_LOADER
	bool "Rockchip USB loader"
	depends on BR2_HOST_GCC_AT_LEAST_4_9 # host-rkdeveloptool
	select BR2_PACKAGE_HOST_RKDEVELOPTOOL
	help
	  Pack a USB loader with rkdeveloptool and copy it to the
	  images directory, to be used with rkdeveloptool in USB
	  download (maskrom) mode.

config BR2_PACKAGE_ROCKCHIP_RKBIN_USB_LOADER_INI
	string "Rockchip rkbin USB loader configuration file path"
	depends on BR2_PACKAGE_ROCKCHIP_RKBIN_USB_LOADER
	help
	  Path to the boot merger configuration file inside the rkbin
	  repository describing the USB loader, e.g.
	  RKBOOT/RV1106MINIALL.ini.

comment "Rockchip USB loader needs a toolchain w/ host gcc >= 4.9"
	depends on !BR2_HOST_GCC_AT_LEAST_4_9

endif # BR2_PACKAGE_ROCKCHIP_RKBIN
```

## package/simple-mail/Config.in
```kconfig
config BR2_PACKAGE_SIMPLE_MAIL
	bool "simple-mail"
	depends on BR2_PACKAGE_QT6
	select BR2_PACKAGE_QT6BASE_NETWORK
	select BR2_PACKAGE_OPENSSL
	help
	  An SMTP library written in C++ for Qt.

	  https://github.com/cutelyst/simple-mail
```

## package/stellarium/Config.in
```kconfig
config BR2_PACKAGE_STELLARIUM
	bool "stellarium"
	depends on BR2_PACKAGE_QT6
	depends on BR2_PACKAGE_QT6_GL_SUPPORTS
	depends on BR2_PACKAGE_HAS_LIBGL # does not support OpenGL ES
	select BR2_PACKAGE_QT6BASE_CONCURRENT
	select BR2_PACKAGE_QT6BASE_GUI
	select BR2_PACKAGE_QT6BASE_NETWORK
	select BR2_PACKAGE_QT6BASE_OPENGL
	select BR2_PACKAGE_QT6BASE_PRINTSUPPORT
	select BR2_PACKAGE_QT6BASE_WIDGETS
	select BR2_PACKAGE_QT6CHARTS
	select BR2_PACKAGE_QT6MULTIMEDIA
	select BR2_PACKAGE_QT6POSITIONING
	select BR2_PACKAGE_QT6SVG
	select BR2_PACKAGE_ZLIB
	help
	  Stellarium is a free open source planetarium for your
	  computer. It shows a realistic sky in 3D, just like what
	  you see with the naked eye, binoculars or a telescope.

	  https://stellarium.org

comment "stellarium needs Qt6 and an OpenGL provider"
	depends on !BR2_PACKAGE_QT6 || !BR2_PACKAGE_HAS_LIBGL
```
