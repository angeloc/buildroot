## board/luckfox/pico-mini/b/boot.its
```
/dts-v1/;

/ {
	description = "Luckfox Pico Mini B kernel and devicetree";
	#address-cells = <1>;

	images {
		kernel {
			description = "Linux kernel";
			data = /incbin/("zImage");
			type = "kernel";
			arch = "arm";
			os = "linux";
			compression = "none";
			load = <0x00800000>;
			entry = <0x00800000>;
			hash-1 {
				algo = "sha256";
			};
		};

		fdt {
			description = "Luckfox Pico Mini B devicetree";
			data = /incbin/("rv1103-luckfox-pico-mini-b.dtb");
			type = "flat_dt";
			arch = "arm";
			compression = "none";
			hash-1 {
				algo = "sha256";
			};
		};
	};

	configurations {
		default = "conf";

		conf {
			description = "Luckfox Pico Mini B";
			kernel = "kernel";
			fdt = "fdt";
		};
	};
};
```

## configs/lichee_rv_dock_defconfig
```kconfig
BR2_riscv=y
BR2_GLOBAL_PATCH_DIR="board/lichee_rv/patches_rv_dock"
BR2_TOOLCHAIN_EXTERNAL=y
BR2_TOOLCHAIN_EXTERNAL_BOOTLIN_RISCV64_LP64D_UCLIBC_STABLE=y
BR2_ROOTFS_OVERLAY="board/lichee_rv/overlay board/lichee_rv/overlay_dock"
BR2_ROOTFS_POST_IMAGE_SCRIPT="support/scripts/genimage.sh"
BR2_ROOTFS_POST_SCRIPT_ARGS="-c board/lichee_rv/genimage.cfg"
BR2_LINUX_KERNEL=y
BR2_LINUX_KERNEL_CUSTOM_TARBALL=y
BR2_LINUX_KERNEL_CUSTOM_TARBALL_LOCATION="$(call github,smaeul,linux,f4bce410a6b47606557cb0d291572afc4c240c85)/linux-f4bce410a6b47606557cb0d291572afc4c240c85.tar.gz"
BR2_LINUX_KERNEL_USE_CUSTOM_CONFIG=y
BR2_LINUX_KERNEL_CUSTOM_CONFIG_FILE="board/lichee_rv/linux-config"
BR2_LINUX_KERNEL_DTS_SUPPORT=y
BR2_LINUX_KERNEL_INTREE_DTS_NAME="allwinner/sun20i-d1-lichee-rv-dock"
BR2_LINUX_KERNEL_INSTALL_TARGET=y
BR2_PACKAGE_RTL8723DS=y
BR2_PACKAGE_WPA_SUPPLICANT=y
BR2_PACKAGE_WPA_SUPPLICANT_AUTOSCAN=y
BR2_TARGET_ROOTFS_EXT2=y
BR2_TARGET_ROOTFS_EXT2_4=y
# BR2_TARGET_ROOTFS_TAR is not set
BR2_TARGET_OPENSBI=y
BR2_TARGET_OPENSBI_CUSTOM_TARBALL=y
BR2_TARGET_OPENSBI_CUSTOM_TARBALL_LOCATION="$(call github,smaeul,opensbi,4bcaf9aa1dbc69ccb68998c7d462ef895163d493)/opensbi-4bcaf9aa1dbc69ccb68998c7d462ef895163d493.tar.gz"
BR2_TARGET_OPENSBI_PLAT="generic"
# BR2_TARGET_OPENSBI_INSTALL_JUMP_IMG is not set
BR2_TARGET_SUN20I_D1_SPL=y
BR2_TARGET_UBOOT=y
BR2_TARGET_UBOOT_BUILD_SYSTEM_KCONFIG=y
BR2_TARGET_UBOOT_CUSTOM_TARBALL=y
BR2_TARGET_UBOOT_CUSTOM_TARBALL_LOCATION="$(call github,smaeul,u-boot,7446a47204fd8923b99ced0091667979c4fd27fa)/uboot-7446a47204fd8923b99ced0091667979c4fd27fa.tar.gz"
BR2_TARGET_UBOOT_BOARD_DEFCONFIG="lichee_rv"
BR2_TARGET_UBOOT_NEEDS_DTC=y
BR2_TARGET_UBOOT_NEEDS_PYLIBFDT=y
BR2_TARGET_UBOOT_NEEDS_OPENSSL=y
BR2_TARGET_UBOOT_NEEDS_OPENSBI=y
# BR2_TARGET_UBOOT_FORMAT_BIN is not set
BR2_TARGET_UBOOT_FORMAT_CUSTOM=y
BR2_TARGET_UBOOT_FORMAT_CUSTOM_NAME="u-boot.toc1"
BR2_PACKAGE_HOST_GENIMAGE=y
```

## configs/luckfox_pico_mini_a_defconfig
```kconfig
BR2_arm=y
BR2_cortex_a7=y
BR2_ARM_FPU_NEON_VFPV4=y
BR2_TOOLCHAIN_EXTERNAL=y
BR2_TOOLCHAIN_EXTERNAL_BOOTLIN=y
BR2_TOOLCHAIN_EXTERNAL_BOOTLIN_ARMV7_EABIHF_GLIBC_STABLE=y
BR2_GLOBAL_PATCH_DIR="board/luckfox/pico-mini/patches"
BR2_DOWNLOAD_FORCE_CHECK_HASHES=y
BR2_TARGET_GENERIC_GETTY_PORT="ttyS2"
BR2_ROOTFS_POST_BUILD_SCRIPT="board/luckfox/pico-mini/a/post-build.sh"
BR2_ROOTFS_POST_IMAGE_SCRIPT="support/scripts/genimage.sh"
BR2_ROOTFS_POST_SCRIPT_ARGS="-c board/luckfox/pico-mini/a/genimage.cfg"
BR2_LINUX_KERNEL=y
BR2_LINUX_KERNEL_CUSTOM_TARBALL=y
BR2_LINUX_KERNEL_CUSTOM_TARBALL_LOCATION="$(call github,angeloc,linux,55812b8dd14318ab2bc499bc31499f93321526c8)/linux-55812b8dd14318ab2bc499bc31499f93321526c8.tar.gz"
BR2_LINUX_KERNEL_USE_CUSTOM_CONFIG=y
BR2_LINUX_KERNEL_CUSTOM_CONFIG_FILE="board/luckfox/pico-mini/linux.config"
BR2_LINUX_KERNEL_DTS_SUPPORT=y
BR2_LINUX_KERNEL_INTREE_DTS_NAME="rockchip/rv1103-luckfox-pico-mini-a"
BR2_LINUX_KERNEL_INSTALL_TARGET=y
BR2_PACKAGE_ROCKCHIP_RKBIN=y
BR2_PACKAGE_ROCKCHIP_RKBIN_TPL_FILENAME="bin/rv11/rv1106_ddr_924MHz_v1.15.bin"
BR2_TARGET_ROOTFS_EXT2=y
BR2_TARGET_ROOTFS_EXT2_4=y
BR2_TARGET_ROOTFS_EXT2_SIZE="64M"
# BR2_TARGET_ROOTFS_TAR is not set
BR2_TARGET_UBOOT=y
BR2_TARGET_UBOOT_BUILD_SYSTEM_KCONFIG=y
BR2_TARGET_UBOOT_CUSTOM_TARBALL=y
BR2_TARGET_UBOOT_CUSTOM_TARBALL_LOCATION="$(call github,angeloc,u-boot,439f93065967456d0e0f8863738595ad387f620e)/u-boot-439f93065967456d0e0f8863738595ad387f620e.tar.gz"
BR2_TARGET_UBOOT_BOARD_DEFCONFIG="luckfox-pico-mini-a-rv1103"
BR2_TARGET_UBOOT_CONFIG_FRAGMENT_FILES="board/luckfox/pico-mini/a/u-boot.fragment"
BR2_TARGET_UBOOT_NEEDS_DTC=y
BR2_TARGET_UBOOT_NEEDS_PYLIBFDT=y
BR2_TARGET_UBOOT_NEEDS_PYELFTOOLS=y
BR2_TARGET_UBOOT_NEEDS_OPENSSL=y
BR2_TARGET_UBOOT_NEEDS_GNUTLS=y
BR2_TARGET_UBOOT_NEEDS_ROCKCHIP_RKBIN=y
# BR2_TARGET_UBOOT_FORMAT_BIN is not set
BR2_TARGET_UBOOT_FORMAT_CUSTOM=y
BR2_TARGET_UBOOT_FORMAT_CUSTOM_NAME="u-boot-rockchip.bin"
BR2_PACKAGE_HOST_GENIMAGE=y
```

## configs/luckfox_pico_mini_b_defconfig
```kconfig
BR2_arm=y
BR2_cortex_a7=y
BR2_ARM_FPU_NEON_VFPV4=y
BR2_TOOLCHAIN_EXTERNAL=y
BR2_TOOLCHAIN_EXTERNAL_BOOTLIN=y
BR2_TOOLCHAIN_EXTERNAL_BOOTLIN_ARMV7_EABIHF_GLIBC_STABLE=y
BR2_GLOBAL_PATCH_DIR="board/luckfox/pico-mini/patches"
BR2_DOWNLOAD_FORCE_CHECK_HASHES=y
BR2_TARGET_GENERIC_GETTY_PORT="ttyS2"
BR2_ROOTFS_POST_IMAGE_SCRIPT="board/luckfox/pico-mini/b/post-image.sh"
BR2_LINUX_KERNEL=y
BR2_LINUX_KERNEL_CUSTOM_TARBALL=y
BR2_LINUX_KERNEL_CUSTOM_TARBALL_LOCATION="$(call github,angeloc,linux,55812b8dd14318ab2bc499bc31499f93321526c8)/linux-55812b8dd14318ab2bc499bc31499f93321526c8.tar.gz"
BR2_LINUX_KERNEL_USE_CUSTOM_CONFIG=y
BR2_LINUX_KERNEL_CUSTOM_CONFIG_FILE="board/luckfox/pico-mini/linux.config"
BR2_LINUX_KERNEL_DTS_SUPPORT=y
BR2_LINUX_KERNEL_INTREE_DTS_NAME="rockchip/rv1103-luckfox-pico-mini-b"
BR2_PACKAGE_MTD=y
BR2_PACKAGE_ROCKCHIP_RKBIN=y
BR2_PACKAGE_ROCKCHIP_RKBIN_TPL_FILENAME="bin/rv11/rv1106_ddr_924MHz_v1.15.bin"
BR2_PACKAGE_ROCKCHIP_RKBIN_USB_LOADER=y
BR2_PACKAGE_ROCKCHIP_RKBIN_USB_LOADER_INI="RKBOOT/RV1106MINIALL.ini"
# BR2_TARGET_ROOTFS_TAR is not set
BR2_TARGET_ROOTFS_UBI=y
BR2_TARGET_ROOTFS_UBI_SUBSIZE=2048
BR2_TARGET_ROOTFS_UBIFS_LEBSIZE=0x1f000
BR2_TARGET_ROOTFS_UBIFS_OPTS="-F"
BR2_TARGET_UBOOT=y
BR2_TARGET_UBOOT_BUILD_SYSTEM_KCONFIG=y
BR2_TARGET_UBOOT_CUSTOM_TARBALL=y
BR2_TARGET_UBOOT_CUSTOM_TARBALL_LOCATION="$(call github,angeloc,u-boot,439f93065967456d0e0f8863738595ad387f620e)/u-boot-439f93065967456d0e0f8863738595ad387f620e.tar.gz"
BR2_TARGET_UBOOT_BOARD_DEFCONFIG="luckfox-pico-mini-b-rv1103"
BR2_TARGET_UBOOT_CONFIG_FRAGMENT_FILES="board/luckfox/pico-mini/b/u-boot.fragment"
BR2_TARGET_UBOOT_NEEDS_DTC=y
BR2_TARGET_UBOOT_NEEDS_PYLIBFDT=y
BR2_TARGET_UBOOT_NEEDS_PYELFTOOLS=y
BR2_TARGET_UBOOT_NEEDS_OPENSSL=y
BR2_TARGET_UBOOT_NEEDS_GNUTLS=y
BR2_TARGET_UBOOT_NEEDS_ROCKCHIP_RKBIN=y
# BR2_TARGET_UBOOT_FORMAT_BIN is not set
BR2_TARGET_UBOOT_FORMAT_CUSTOM=y
BR2_TARGET_UBOOT_FORMAT_CUSTOM_NAME="idbloader.img u-boot.img"
BR2_PACKAGE_HOST_UBOOT_TOOLS=y
BR2_PACKAGE_HOST_UBOOT_TOOLS_FIT_SUPPORT=y
```

## package/cutekeyboard/Config.in
```kconfig
config BR2_PACKAGE_CUTEKEYBOARD
	bool "cutekeyboard"
	depends on BR2_PACKAGE_QT6
	select BR2_PACKAGE_QT6DECLARATIVE
	select BR2_PACKAGE_QT6DECLARATIVE_QUICK
	help
	  CuteKeyboard is a Qt virtual keyboard plugin for
	  embedded applications.

	  https://amarula.github.io/cutekeyboard/

if BR2_PACKAGE_CUTEKEYBOARD

config BR2_PACKAGE_CUTEKEYBOARD_EXAMPLES
	bool "cutekeyboard examples"
	help
	  Compile also application example

endif
```

## package/cutelyst/Config.in
```kconfig
config BR2_PACKAGE_CUTELYST
	bool "cutelyst"
	depends on BR2_PACKAGE_QT6
	depends on BR2_TOOLCHAIN_GCC_AT_LEAST_11 # C++23, coroutines
	depends on BR2_TOOLCHAIN_HEADERS_AT_LEAST_3_3
	select BR2_HOST_CMAKE_AT_LEAST_3_28
	select BR2_PACKAGE_HOST_QT6TOOLS
	select BR2_PACKAGE_HOST_QT6TOOLS_LINGUIST_TOOLS
	select BR2_PACKAGE_QT6BASE_NETWORK
	select BR2_PACKAGE_QT6BASE_SQL
	help
	  A C++ Web Framework built on top of Qt, using
	  the simple approach of Catalyst (Perl) framework.

	  https://cutelyst.org

comment "cutelyst needs a toolchain w/ gcc >= 11, headers >= 3.3"
	depends on BR2_PACKAGE_QT6
	depends on !BR2_TOOLCHAIN_GCC_AT_LEAST_11 || \
		!BR2_TOOLCHAIN_HEADERS_AT_LEAST_3_3
```

## package/grantlee/Config.in
```kconfig
config BR2_PACKAGE_GRANTLEE
	bool "grantlee"
	depends on BR2_PACKAGE_QT6
	select BR2_PACKAGE_QT6BASE_GUI
	select BR2_PACKAGE_QT6DECLARATIVE
	help
	  Qt implementation of the Django template framework

	  http://www.grantlee.org
```

## package/kf6/Config.in
```kconfig
menuconfig BR2_PACKAGE_KF6
	bool "KF6"
	depends on BR2_PACKAGE_QT6
	depends on BR2_TOOLCHAIN_GCC_AT_LEAST_10 # C++20
	help
	  This option enables the KF6 KDE Frameworks. Sub-options
	  allow to select which modules should be built.

	  https://develop.kde.org/products/frameworks/

if BR2_PACKAGE_KF6
source "package/kf6/kf6-extra-cmake-modules/Config.in"
endif

comment "KF6 needs a toolchain w/ gcc >= 10"
	depends on BR2_PACKAGE_QT6
	depends on !BR2_TOOLCHAIN_GCC_AT_LEAST_10
```

## package/kf6/kf6-extra-cmake-modules/Config.in
```kconfig
config BR2_PACKAGE_KF6_EXTRA_CMAKE_MODULES
	bool "kf6-extra-cmake-modules"
	select BR2_HOST_CMAKE_AT_LEAST_3_30
	help
	  KF6 is a set of Qt framework addons, extending Qt in various
	  ways, not only restricted in helping integration in KDE.

	  This package corresponds to the extra CMake modules,
	  required for most KF6 libraries.

	  https://api.kde.org/ecm/
```

## package/kf6/kf6-kcoreaddons/Config.in
```kconfig
config BR2_PACKAGE_KF6_KCOREADDONS
	bool "kf6-kcoreaddons"
	select BR2_PACKAGE_HOST_QT6TOOLS
	select BR2_PACKAGE_HOST_QT6TOOLS_LINGUIST_TOOLS
	select BR2_PACKAGE_KF6_EXTRA_CMAKE_MODULES
	select BR2_PACKAGE_UTIL_LINUX
	select BR2_PACKAGE_UTIL_LINUX_LIBMOUNT
	help
	  KF6 is a set of Qt framework addons, extending Qt in
	  various ways, not only restricted in helping integration
	  in KDE.

	  This package contains KCoreAddons, a set of classes built
	  on top of QtCore to perform various tasks.

	  https://api.kde.org/kcoreaddons-index.html
```

## package/kf6/kf6-modemmanager-qt/Config.in
```kconfig
config BR2_PACKAGE_KF6_MODEMMANAGER_QT
	bool "kf6-modemmanager-qt"
	depends on BR2_PACKAGE_MODEM_MANAGER
	select BR2_PACKAGE_KF6_EXTRA_CMAKE_MODULES
	select BR2_PACKAGE_QT6BASE_DBUS
	select BR2_PACKAGE_QT6BASE_XML
	help
	  KF6 is a set of Qt framework addons, extending Qt in various
	  ways, not only restricted in helping integration in KDE.

	  This package contains the ModemManager Qt6 bindings from the
	  KF6 project.

	  https://api.kde.org/modemmanager-qt-index.html
```

## package/kf6/kf6-networkmanager-qt/Config.in
```kconfig
config BR2_PACKAGE_KF6_NETWORKMANAGER_QT
	bool "kf6-networkmanager-qt"
	depends on BR2_PACKAGE_NETWORK_MANAGER
	select BR2_PACKAGE_KF6_EXTRA_CMAKE_MODULES
	select BR2_PACKAGE_QT6BASE_DBUS
	select BR2_PACKAGE_QT6BASE_NETWORK
	select BR2_PACKAGE_QT6DECLARATIVE
	help
	  KF6 is a set of Qt framework addons, extending Qt in various
	  ways, not only restricted in helping integration in KDE.

	  This package contains the NetworkManager Qt6 bindings from
	  the KF6 project.

	  https://api.kde.org/networkmanager-qt-index.html
```

## package/libmediaart/Config.in
```kconfig
comment "libmediaart needs a toolchain w/ wchar, threads"
	depends on BR2_USE_MMU
	depends on !BR2_USE_WCHAR || !BR2_TOOLCHAIN_HAS_THREADS

config BR2_PACKAGE_LIBMEDIAART
	bool "libmediaart"
	depends on BR2_USE_MMU # glib2
	depends on BR2_USE_WCHAR # glib2
	depends on BR2_TOOLCHAIN_HAS_THREADS # glib2
	select BR2_PACKAGE_GDK_PIXBUF
	select BR2_PACKAGE_LIBGLIB2
	help
	  Library tasked with managing, extracting and handling media
	  art caches

	  https://github.com/GNOME/libmediaart
```

## package/log4qt/Config.in
```kconfig
config BR2_PACKAGE_LOG4QT
	bool "log4qt"
	depends on BR2_PACKAGE_QT6
	depends on BR2_TOOLCHAIN_GCC_AT_LEAST_11 # C++20, std::source_location
	select BR2_HOST_CMAKE_AT_LEAST_3_28
	select BR2_PACKAGE_QT6BASE_CONCURRENT
	help
	  Log4Qt is a C++ port of the Apache Software Foundation
	  Log4j package using the Qt Framework. It is intended to be
	  used by open source and commercial Qt projects.

	  https://github.com/MEONMedical/Log4Qt

comment "log4qt needs qt6 and a toolchain w/ gcc >= 11"
	depends on !BR2_PACKAGE_QT6 || !BR2_TOOLCHAIN_GCC_AT_LEAST_11
```

## package/overlayfs/Config.in
```kconfig
config BR2_PACKAGE_OVERLAYFS
	bool
	help
	  Overlayfs support scripts for enabling overlayfs
```

## package/pinentry/Config.in
```kconfig
menuconfig BR2_PACKAGE_PINENTRY
	bool "pinentry"
	depends on BR2_PACKAGE_LIBGPG_ERROR_ARCH_SUPPORTS # libgpg-error
	depends on BR2_USE_MMU # libassuan
	select BR2_PACKAGE_LIBASSUAN
	select BR2_PACKAGE_LIBGPG_ERROR
	# At least one backend is needed to avoid build breakage
	select BR2_PACKAGE_PINENTRY_NCURSES if \
		!BR2_PACKAGE_PINENTRY_QT6
	help
	  A collection of simple PIN or pass-phrase entry dialogs

	  https://www.gnupg.org/related_software/pinentry/

if BR2_PACKAGE_PINENTRY

config BR2_PACKAGE_PINENTRY_EFL
	bool "pinentry-efl"
	depends on BR2_PACKAGE_EFL
	depends on BR2_PACKAGE_XORG7
	select BR2_PACKAGE_EFL_X_XLIB
	help
	  The pinentry-efl tool

comment "pinentry-efl needs efl and X"
	depends on !BR2_PACKAGE_EFL || !BR2_PACKAGE_XORG7

config BR2_PACKAGE_PINENTRY_FLTK
	bool "pinentry-fltk"
	depends on BR2_USE_MMU # fltk
	depends on BR2_INSTALL_LIBSTDCPP # fltk
	depends on BR2_PACKAGE_XORG7 # fltk
	select BR2_PACKAGE_FLTK
	help
	  The pinentry-fltk tool

comment "pinentry-fltk needs X and a toolchain w/ C++"
	depends on BR2_USE_MMU
	depends on !BR2_PACKAGE_XORG7 || !BR2_INSTALL_LIBSTDCPP

config BR2_PACKAGE_PINENTRY_NCURSES
	bool "pinentry-ncurses"
	select BR2_PACKAGE_NCURSES
	select BR2_PACKAGE_LIBICONV if !BR2_ENABLE_LOCALE
	help
	  The pinentry-ncurses tool

config BR2_PACKAGE_PINENTRY_QT6
	bool "pinentry-qt"
	depends on BR2_INSTALL_LIBSTDCPP # qt6
	depends on BR2_TOOLCHAIN_GCC_AT_LEAST_8 # qt6
	depends on BR2_HOST_GCC_AT_LEAST_8 # qt6
	depends on BR2_PACKAGE_QT6_ARCH_SUPPORTS # qt6
	depends on BR2_TOOLCHAIN_HAS_THREADS # qt6
	depends on BR2_USE_WCHAR # qt6
	depends on !BR2_STATIC_LIBS # qt6
	select BR2_PACKAGE_QT6
	select BR2_PACKAGE_QT6BASE_GUI
	select BR2_PACKAGE_QT6BASE_WIDGETS
	help
	  The pinentry-qt tool, using Qt6

comment "pinentry-qt needs a toolchain w/ C++, threads, wchar, dynamic library, gcc >= 8, host gcc >= 8"
	depends on BR2_PACKAGE_QT6_ARCH_SUPPORTS
	depends on !BR2_INSTALL_LIBSTDCPP || !BR2_TOOLCHAIN_GCC_AT_LEAST_8 || \
		!BR2_HOST_GCC_AT_LEAST_8 || !BR2_TOOLCHAIN_HAS_THREADS || \
		!BR2_USE_WCHAR || BR2_STATIC_LIBS

endif
```

## package/pulseview/Config.in
```kconfig
config BR2_PACKAGE_PULSEVIEW
	bool "pulseview"
	depends on BR2_PACKAGE_QT6
	depends on BR2_TOOLCHAIN_SUPPORTS_ALWAYS_LOCKFREE_ATOMIC_INTS # boost-filesystem
	depends on BR2_ENABLE_LOCALE # libsigrok
	select BR2_PACKAGE_BOOST
	select BR2_PACKAGE_BOOST_FILESYSTEM
	select BR2_PACKAGE_BOOST_SERIALIZATION
	select BR2_PACKAGE_BOOST_SYSTEM
	select BR2_PACKAGE_HOST_QT6TOOLS
	select BR2_PACKAGE_HOST_QT6TOOLS_LINGUIST_TOOLS
	select BR2_PACKAGE_LIBSIGROK
	select BR2_PACKAGE_LIBSIGROKCXX
	select BR2_PACKAGE_QT6BASE_GUI
	select BR2_PACKAGE_QT6BASE_PNG
	select BR2_PACKAGE_QT6BASE_WIDGETS
	select BR2_PACKAGE_QT6SVG
	help
	  PulseView is a Qt based logic analyzer, oscilloscope
	  and MSO GUI for sigrok.

	  http://sigrok.org/wiki/PulseView

comment "pulseview needs a toolchain w/ locale"
	depends on BR2_PACKAGE_QT6
	depends on BR2_TOOLCHAIN_SUPPORTS_ALWAYS_LOCKFREE_ATOMIC_INTS
	depends on !BR2_ENABLE_LOCALE
```
