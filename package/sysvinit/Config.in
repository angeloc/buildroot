## package/sysvinit/Config.in
```kconfig
config BR2_PACKAGE_SYSVINIT
	bool "sysvinit"
	depends on BR2_USE_MMU # fork()
	depends on BR2_INIT_SYSV
	depends on BR2_PACKAGE_BUSYBOX_SHOW_OTHERS
	select BR2_PACKAGE_OVERLAYFS if BR2_ENABLE_OVERLAYFS
	help
	  System V style implementation of /sbin/init, parent of all
	  processes

	  http://savannah.nongnu.org/projects/sysvinit
```

## package/wireshark/Config.in
```kconfig
config BR2_PACKAGE_WIRESHARK
	bool "wireshark"
	depends on BR2_PACKAGE_LIBGPG_ERROR_ARCH_SUPPORTS # libgcrypt -> libgpg-error
	depends on !BR2_STATIC_LIBS
	depends on BR2_USE_MMU # fork(), glib2
	depends on BR2_USE_WCHAR # glib2
	depends on BR2_TOOLCHAIN_HAS_THREADS # glib2
	depends on BR2_INSTALL_LIBSTDCPP
	select BR2_PACKAGE_C_ARES
	select BR2_PACKAGE_LIBPCAP
	select BR2_PACKAGE_LIBGCRYPT
	select BR2_PACKAGE_LIBGLIB2
	select BR2_PACKAGE_LIBXML2
	select BR2_PACKAGE_PCRE2
	select BR2_PACKAGE_SPEEXDSP
	help
	  Network traffic sniffer and protocol decoder.

	  https://www.wireshark.org

if BR2_PACKAGE_WIRESHARK

config BR2_PACKAGE_WIRESHARK_GUI
	bool "Qt6 GUI"
	default y
	depends on BR2_INSTALL_LIBSTDCPP # qt6
	depends on BR2_TOOLCHAIN_GCC_AT_LEAST_8 # qt6
	depends on BR2_HOST_GCC_AT_LEAST_8 # qt6
	depends on BR2_PACKAGE_QT6_ARCH_SUPPORTS # qt6
	depends on !BR2_PACKAGE_QT5 # qt6
	select BR2_PACKAGE_QT6
	select BR2_PACKAGE_QT6BASE_CONCURRENT
	select BR2_PACKAGE_QT6BASE_FONTCONFIG # runtime
	select BR2_PACKAGE_QT6BASE_GUI
	select BR2_PACKAGE_QT6BASE_PNG # runtime
	select BR2_PACKAGE_QT6BASE_PRINTSUPPORT
	select BR2_PACKAGE_QT6BASE_WIDGETS
	select BR2_PACKAGE_QT6CORE5COMPAT
	select BR2_PACKAGE_QT6MULTIMEDIA
	select BR2_PACKAGE_QT6SVG
	select BR2_PACKAGE_HOST_QT6TOOLS
	select BR2_PACKAGE_HOST_QT6TOOLS_LINGUIST_TOOLS
	help
	  Enable Qt6 GUI

comment "Qt6 GUI needs a toolchain w/ C++, gcc >= 8, host gcc >= 8"
	depends on BR2_PACKAGE_QT6_ARCH_SUPPORTS
	depends on !BR2_PACKAGE_QT5
	depends on !BR2_INSTALL_LIBSTDCPP || \
		!BR2_TOOLCHAIN_GCC_AT_LEAST_8 || !BR2_HOST_GCC_AT_LEAST_8

endif # BR2_PACKAGE_WIRESHARK

comment "wireshark needs a toolchain w/ wchar, threads, dynamic library, C++"
	depends on BR2_PACKAGE_LIBGPG_ERROR_ARCH_SUPPORTS
	depends on BR2_USE_MMU
	depends on !BR2_USE_WCHAR || !BR2_TOOLCHAIN_HAS_THREADS || \
		BR2_STATIC_LIBS || !BR2_INSTALL_LIBSTDCPP
```
